## package/nxp/qoriq-optee-client/Config.in
```kconfig
comment "qorir-optee-client works on the arm architecture"
	depends on BR2_arm

config BR2_PACKAGE_QORIQ_OPTEE_CLIENT
	bool "qoriq-optee-client"
	help
	  The qoriq-optee-client, containing the source code
	  for the TEE client library in Linux.
	  This component provides the TEE Client API as
	  defined by the GlobalPlatform TEE standard.
```

## package/nxp/qoriq-optee-os/Config.in
```kconfig
comment "qoriq-optee-os works on arm platform"
	depends on BR2_arm

config BR2_PACKAGE_QORIQ_OPTEE_OS
	bool "qoriq-optee-os"
	help
	  The qoriq-optee-os git, contains the source code for
	  the TEE in Linux using the ARM® TrustZone®
	  technology. This component meets the GlobalPlatform
	  TEE System Architecture specification. It also
	  provides the TEE Internal core API v1.1 as defined
	  by the GlobalPlatform TEE Standard for the development
	  of Trusted Applications. For a general overview of
	  OP-TEE and to find out how to contribute, please
	  see the Notice.md file.
```

## package/nxp/qoriq-perl-exporter-tiny/Config.in
```kconfig
config BR2_PACKAGE_QORIQ_PERL_EXPORTER_TINY
	bool "qoriq-perl-exporter-tiny"
	help
	  Exporter::Tiny - an exporter with the features of Sub::Exporter
	  but only core dependencies

	  https://metacpan.org/release/Exporter-Tiny
```

## package/nxp/qoriq-sja1105-ptp/Config.in
```kconfig
config BR2_PACKAGE_QORIQ_SJA1105_PTP
	bool "qoriq-sja1105-ptp"
	help
	  This software implements a IEEE 1588 2-step End-to-End
	  transparent clock on SJA1105 switch.
```

## package/nxp/qoriq-transapi/Config.in
```kconfig
config BR2_PACKAGE_QORIQ_TRANSAPI
	bool "qoriq-transapi"
	depends on !BR2_PACKAGE_QORIQ_YANG_CFGINTERFACES
	select BR2_PACKAGE_QORIQ_TSNTOOL
	select BR2_PACKAGE_QORIQ_NETOPEER
	select BR2_PACKAGE_QORIQ_YANG_MODEL
	help
	  configue tsn feature based on netopeer project.

if BR2_PACKAGE_QORIQ_TRANSAPI
choice
	prompt "platform"

config BR2_PACKAGE_QORIQ_TRANSAPI_LS1028ARDB
	bool "LS1028ARDB"

endchoice

endif
```

## package/nxp/qoriq-yang-sja1105/Config.in
```kconfig
config BR2_PACKAGE_QORIQ_YANG_SJA1105
	bool "qoriq-yang-sja1105"
	select BR2_PACKAGE_QORIQ_SJA1105_TOOL
	select BR2_PACKAGE_QORIQ_NETOPEER
	help
	  netopeer yang model NXP sja1105
```
